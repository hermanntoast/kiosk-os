## configs/kiosk_x86_64_defconfig
```kconfig
# Kiosk OS - Buildroot Configuration
# x86_64 with Chromium Kiosk Mode

# Architecture
BR2_x86_64=y
BR2_x86_corei7=y

# Toolchain
BR2_TOOLCHAIN_BUILDROOT_GLIBC=y
BR2_TOOLCHAIN_BUILDROOT_CXX=y

# Kernel
BR2_LINUX_KERNEL=y
BR2_LINUX_KERNEL_USE_DEFCONFIG=y
BR2_LINUX_KERNEL_DEFCONFIG="x86_64"
BR2_LINUX_KERNEL_INSTALL_TARGET=y

# System configuration
BR2_TARGET_GENERIC_HOSTNAME="kiosk"
BR2_TARGET_GENERIC_ISSUE="Kiosk OS"
BR2_SYSTEM_BIN_SH_BASH=y
BR2_INIT_BUSYBOX=y
BR2_ROOTFS_DEVICE_CREATION_DYNAMIC_EUDEV=y
BR2_ENABLE_LOCALE_PURGE=y
BR2_ENABLE_LOCALE_WHITELIST="C en_US de_DE"

# Root filesystem overlay
BR2_ROOTFS_OVERLAY="$(BR2_EXTERNAL_KIOSK_PATH)/board/kiosk/rootfs_overlay"
BR2_ROOTFS_POST_BUILD_SCRIPT="$(BR2_EXTERNAL_KIOSK_PATH)/board/kiosk/post-build.sh"

# Filesystem images
BR2_TARGET_ROOTFS_EXT2=y
BR2_TARGET_ROOTFS_EXT2_4=y
BR2_TARGET_ROOTFS_EXT2_SIZE="1G"
BR2_TARGET_ROOTFS_ISO9660=y
BR2_TARGET_ROOTFS_ISO9660_BOOT_MENU="$(BR2_EXTERNAL_KIOSK_PATH)/board/kiosk/isolinux.cfg"

# Bootloader
BR2_TARGET_SYSLINUX=y
BR2_TARGET_SYSLINUX_ISOLINUX=y

# X.org Server
BR2_PACKAGE_XORG7=y
BR2_PACKAGE_XSERVER_XORG_SERVER=y
BR2_PACKAGE_XSERVER_XORG_SERVER_MODULAR=y

# X.org Drivers
BR2_PACKAGE_XF86_INPUT_EVDEV=y
BR2_PACKAGE_XF86_INPUT_KEYBOARD=y
BR2_PACKAGE_XF86_INPUT_MOUSE=y
BR2_PACKAGE_XF86_INPUT_LIBINPUT=y
BR2_PACKAGE_XF86_VIDEO_FBDEV=y
BR2_PACKAGE_XF86_VIDEO_VESA=y
BR2_PACKAGE_XF86_VIDEO_INTEL=y

# X.org Applications
BR2_PACKAGE_XTERM=y
BR2_PACKAGE_XINIT=y
BR2_PACKAGE_XAUTH=y

# Mesa3D for software/hardware rendering
BR2_PACKAGE_MESA3D=y
BR2_PACKAGE_MESA3D_GALLIUM_DRIVER_SWRAST=y
BR2_PACKAGE_MESA3D_GALLIUM_DRIVER_IRIS=y
BR2_PACKAGE_MESA3D_OPENGL_GLX=y
BR2_PACKAGE_MESA3D_OPENGL_EGL=y

# D-Bus (required for Chromium)
BR2_PACKAGE_DBUS=y
BR2_PACKAGE_DBUS_X11=y

# Fonts
BR2_PACKAGE_FONTCONFIG=y
BR2_PACKAGE_DEJAVU=y
BR2_PACKAGE_LIBERATION=y

# Libraries needed by Chromium
BR2_PACKAGE_ALSA_LIB=y
BR2_PACKAGE_LIBDRM=y
BR2_PACKAGE_LIBXKBCOMMON=y
BR2_PACKAGE_WAYLAND=y
BR2_PACKAGE_WAYLAND_PROTOCOLS=y
BR2_PACKAGE_LIBXSHMFENCE=y
BR2_PACKAGE_LIBXDAMAGE=y
BR2_PACKAGE_PANGO=y
BR2_PACKAGE_CAIRO=y
BR2_PACKAGE_HARFBUZZ=y
BR2_PACKAGE_NOTO_SANS_CJK_JP=y

# Chromium
BR2_PACKAGE_CHROMIUM=y

# Splash Screen
BR2_PACKAGE_PSPLASH=y

# Utilities
BR2_PACKAGE_BUSYBOX_SHOW_OTHERS=y
BR2_PACKAGE_FBV=y
BR2_PACKAGE_UTIL_LINUX=y
BR2_PACKAGE_UTIL_LINUX_BINARIES=y
BR2_PACKAGE_SETXKBMAP=y
BR2_PACKAGE_XKB_DATA=y
BR2_PACKAGE_XKBCOMP=y
BR2_PACKAGE_XKEYBOARD_CONFIG=y

# Networking
BR2_PACKAGE_DHCPCD=y
BR2_PACKAGE_DROPBEAR=y
BR2_PACKAGE_WIRELESS_TOOLS=y
BR2_PACKAGE_WPA_SUPPLICANT=y
BR2_PACKAGE_WPA_SUPPLICANT_NL80211=y

# NSS/NSPR for Chromium
BR2_PACKAGE_NSPR=y
BR2_PACKAGE_NSS=y

# Host utilities needed
BR2_PACKAGE_HOST_DOSFSTOOLS=y
BR2_PACKAGE_HOST_MTOOLS=y
BR2_PACKAGE_HOST_SYSLINUX=y
```
